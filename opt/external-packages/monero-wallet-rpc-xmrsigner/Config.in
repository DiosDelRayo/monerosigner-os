## opt/external-packages/monero-wallet-rpc-xmrsigner/Config.in
```kconfig
config BR2_PACKAGE_MONERO_WALLET_RPC_XMRSIGNER
    bool "monero-wallet-rpc-xmrsigner"

    help
      Monero wallet RPC binary with xmrsigner modifications.
      This package provides the pre-compiled monero-wallet-rpc binary
      and its runtime dependencies.
```

## opt/external-packages/monero-wallet-rpc/Config.in
```kconfig
config BR2_PACKAGE_MONERO_WALLET_RPC
	bool "monero-wallet-rpc"
	help
	  Monero Wallet RPC is a standalone wallet that runs as a
	  RPC server, allowing you to interact with your wallet.

	  https://www.getmonero.org/
```

## opt/external-packages/python-monero/Config.in
```kconfig
config BR2_PACKAGE_PYTHON_MONERO
    bool "python-monero"
    select BR2_PACKAGE_PYTHON_PYNACL
    select BR2_PACKAGE_PYTHON_PYCRYPTODOMEX
    select BR2_PACKAGE_PYTHON_REQUESTS
    select BR2_PACKAGE_PYTHON_VARINT
    select BR2_PACKAGE_PYTHON3_ZLIB
    help
  Python library for Monero

      https://github.com/DiosDelRayo/monero-python
```

## opt/external-packages/python-polyseed/Config.in
```kconfig
config BR2_PACKAGE_PYTHON_POLYSEED
    bool "python-polyseed"
    select BR2_PACKAGE_PYTHON3_XZ
    help
  Python library for polyseed

      https://github.com/DiosDelRayo/polyseed-python
```

## opt/external-packages/python-varint/Config.in
```kconfig
config BR2_PACKAGE_PYTHON_VARINT
    bool "python-varint"
    help
      Variable length integer encoding.

      https://github.com/fmoo/python-varint
```

## opt/pi02w/Config.in
```kconfig
source "../external-packages/monero-ots/Config.in"
source "../external-packages/python-mock/Config.in"
source "../external-packages/python-picamera/Config.in"
source "../external-packages/python-pyzbar/Config.in"
source "../external-packages/python-urtypes/Config.in"
```

## opt/pi4/Config.in
```kconfig
source "../external-packages/monero-wallet-rpc/Config.in"
source "../external-packages/monero-wallet-rpc-xmrsigner/Config.in"
source "../external-packages/python-mock/Config.in"
source "../external-packages/python-monero/Config.in"
source "../external-packages/python-picamera/Config.in"
source "../external-packages/python-polyseed/Config.in"
source "../external-packages/python-pyzbar/Config.in"
source "../external-packages/python-urtypes/Config.in"
source "../external-packages/python-varint/Config.in"
```
